## sdkconfig.defaults.esp32c3
```kconfig
# Configuration for use with c3 mini 1 bare board
# Pins:
# Pin# (GPIO#)
# 42-54 GND
# 13 - IO25 ADC use for battery level
# 14 - IO26 Motor on/off (active high)
# 35 - IO3 RXD  - RX  > Bus send
# 36 - IO1 TXD  - TX  > bus receive
# 29 - IO5 > light
#  - RST  - RST
# 3  - VCC  - 3.3V


CONFIG_ION_BUTTON=n
CONFIG_ION_LED_PIN=5
CONFIG_ION_UART=10
CONFIG_ION_RXD=3
CONFIG_ION_TXD=1

CONFIG_ION_LIGHT=y
CONFIG_ION_LIGHT_PIN=5
CONFIG_ION_LIGHT_PIN_INVERTED=n

CONFIG_ION_RELAY=y
CONFIG_ION_RELAY_PIN=26
CONFIG_ION_RELAY_PIN_INVERTED=n

CONFIG_ESP32C3_DEFAULT_CPU_FREQ_160=y

CONFIG_ION_ADC=y
# ADC channel 2 is pin 13
CONFIG_ION_ADC_CHAN=25

# Voltage dividers with a factor of 16 tend to be easy to find resistors for:
# 150k & 10k
# 180k & 12k
# 240k & 16k
# 270k & 18k
# 300k & 20k
# 330k & 22k
# 360k & 24k

# The scale of the divider, times 1000
CONFIG_ION_DIVIDER_SCALE=16000

# Consider 32V (3.2V/cell for 10s) empty
CONFIG_ION_ADC_EMPTY_MV=32000

# Consider 42V (4.2V/cell for 10s) full
CONFIG_ION_ADC_FULL_MV=42000
```
